## meta-coav/conf/layer.conf
```bitbake
BBPATH .= ":${LAYERDIR}"

BBFILES += "${LAYERDIR}/recipes-*/*/*.bb \
            ${LAYERDIR}/recipes-*/*/*.bbappend"

BBFILE_COLLECTIONS += "coav"
BBFILE_PATTERN_coav = "^${LAYERDIR}/"
BBFILE_PRIORITY_coav = "1"

LAYERVERSION_coav = "1"
```
